## application/Kconfig
```kconfig
#===============================================================================
# @brief    Kconfig file.
# Copyright (c) @CompanyNameMagicTag 2023-2023. All rights reserved.
#===============================================================================
osource "application/samples/Kconfig"

config APP_ENABLE
    bool
    prompt "Enable APP."
    default n
    help
        This option means support APPs.
```

## application/samples/Kconfig
```kconfig
#===============================================================================
# @brief    Kconfig file.
# Copyright (c) @CompanyNameMagicTag 2023-2023. All rights reserved.
#===============================================================================
config SAMPLE_ENABLE
    bool
    prompt "Enable Sample."
    default n
    help
        This option means support Samples.

config ENABLE_WIFI_SAMPLE
    bool
    prompt "Enable the Sample of WIFI."
    default n
    depends on SAMPLE_ENABLE
    help
        This option means enable the sample of WIFI.

if SAMPLE_ENABLE
    osource "application/samples/bt/Kconfig"
    osource "application/samples/peripheral/Kconfig"
    osource "application/samples/wifi/Kconfig"
    osource "application/samples/products/Kconfig"
endif
```

## application/samples/peripheral/Kconfig
```kconfig
#===============================================================================
# @brief    Kconfig file.
# Copyright (c) @CompanyNameMagicTag 2023-2023. All rights reserved.
#===============================================================================
config ENABLE_PERIPHERAL_SAMPLE
    bool
    prompt "Enable the Sample of peripheral."
    default n
    depends on SAMPLE_ENABLE
    help
        This option means enable the sample of peripheral.

config SAMPLE_SUPPORT_ADC
    bool
    prompt "Support ADC Sample."
    default n
    depends on ENABLE_PERIPHERAL_SAMPLE
    help
        This option means support ADC Sample.

if SAMPLE_SUPPORT_ADC
menu "ADC Sample Configuration"
    osource "application/samples/peripheral/adc/Kconfig"
endmenu
endif

config SAMPLE_SUPPORT_AFE
    bool
    prompt "Support AFE Sample."
    default n
    depends on ENABLE_PERIPHERAL_SAMPLE
    help
        This option means support AFE Sample.

if SAMPLE_SUPPORT_AFE
menu "AFE Sample Configuration"
    osource "application/samples/peripheral/afe/Kconfig"
endmenu
endif

config SAMPLE_SUPPORT_BLINKY
    bool
    prompt "Support BLINKY Sample."
    default n
    depends on ENABLE_PERIPHERAL_SAMPLE
    help
        This option means support BLINKY Sample.

if SAMPLE_SUPPORT_BLINKY
menu "BLINK Sample Configuration"
    osource "application/samples/peripheral/blinky/Kconfig"
endmenu
endif

config SAMPLE_SUPPORT_BUTTON
    bool
    prompt "Support BUTTON Sample."
    default n
    depends on ENABLE_PERIPHERAL_SAMPLE
    help
        This option means support BUTTON Sample.

config SAMPLE_SUPPORT_CALENDAR
    bool
    prompt "Support CALENDAR Sample."
    default n
    depends on ENABLE_PERIPHERAL_SAMPLE
    help
        This option means support CALENDAR Sample.

if SAMPLE_SUPPORT_CALENDAR
menu "CALENDAR Sample Configuration"
    osource "application/samples/peripheral/calendar/Kconfig"
endmenu
endif

config SAMPLE_SUPPORT_DMA
    bool
    prompt "Support DMA Sample."
    default n
    depends on ENABLE_PERIPHERAL_SAMPLE
    help
        This option means support DMA Sample.

if SAMPLE_SUPPORT_DMA
menu "DMA Sample Configuration"
    osource "application/samples/peripheral/dma/Kconfig"
endmenu
endif

config SAMPLE_SUPPORT_EFLASH
    bool
    prompt "Support EFLASH Sample."
    default n
    depends on ENABLE_PERIPHERAL_SAMPLE
    help
        This option means support EFLASH Sample.

if SAMPLE_SUPPORT_EFLASH
menu "EFLASH Sample Configuration"
    osource "application/samples/peripheral/eflash/Kconfig"
endmenu
endif

config SAMPLE_SUPPORT_I2C
    bool
    prompt "Support I2C Sample."
    default n
    depends on ENABLE_PERIPHERAL_SAMPLE
    help
        This option means support I2C Sample.

if SAMPLE_SUPPORT_I2C
menu "I2C Sample Configuration"
    osource "application/samples/peripheral/i2c/Kconfig"
endmenu
endif

config SAMPLE_SUPPORT_I2S
    bool
    prompt "Support I2S Sample."
    default n
    depends on ENABLE_PERIPHERAL_SAMPLE
    help
        This option means support I2S Sample.

if SAMPLE_SUPPORT_I2S
menu "I2S Sample Configuration"
    osource "application/samples/peripheral/i2s/Kconfig"
endmenu
endif

config SAMPLE_SUPPORT_I2S_DMA
    bool
    prompt "Support I2S DMA Sample."
    default n
    depends on ENABLE_PERIPHERAL_SAMPLE
    help
        This option means support I2S Sample.

if SAMPLE_SUPPORT_I2S_DMA
menu "I2S DMA Sample Configuration"
    osource "application/samples/peripheral/i2s_dma/Kconfig"
endmenu
endif

config SAMPLE_SUPPORT_KEYSCAN
    bool
    prompt "Support KEYSCAN Sample."
    default n
    depends on ENABLE_PERIPHERAL_SAMPLE
    help
        This option means support KEYSCAN Sample.

config SAMPLE_SUPPORT_PDM
    bool
    prompt "Support PDM Sample."
    default n
    depends on ENABLE_PERIPHERAL_SAMPLE
    help
        This option means support PDM Sample.

if SAMPLE_SUPPORT_PDM
menu "PDM Sample Configuration"
    osource "application/samples/peripheral/pdm/Kconfig"
endmenu
endif

config SAMPLE_SUPPORT_PINCTRL
    bool
    prompt "Support PINCTRL Sample."
    default n
    depends on ENABLE_PERIPHERAL_SAMPLE
    help
        This option means support PINCTRL Sample.

if SAMPLE_SUPPORT_PINCTRL
menu "PINCTRL Sample Configuration"
    osource "application/samples/peripheral/pinctrl/Kconfig"
endmenu
endif

config SAMPLE_SUPPORT_PWM
    bool
    prompt "Support PWM Sample."
    default n
    depends on ENABLE_PERIPHERAL_SAMPLE
    help
        This option means support PWM Sample.

if SAMPLE_SUPPORT_PWM
menu "PWM Sample Configuration"
    osource "application/samples/peripheral/pwm/Kconfig"
endmenu
endif

config SAMPLE_SUPPORT_QDEC
    bool
    prompt "Support QDEC Sample."
    default n
    depends on ENABLE_PERIPHERAL_SAMPLE
    help
        This option means support QDEC Sample.

if SAMPLE_SUPPORT_QDEC
menu "QDEC Sample Configuration"
    osource "application/samples/peripheral/qdec/Kconfig"
endmenu
endif

config SAMPLE_SUPPORT_RTC
    bool
    prompt "Support RTC Sample."
    default n
    depends on ENABLE_PERIPHERAL_SAMPLE
    help
        This option means support RTC Sample.

if SAMPLE_SUPPORT_RTC
menu "RTC Sample Configuration"
    osource "application/samples/peripheral/rtc/Kconfig"
endmenu
endif

config SAMPLE_SUPPORT_SPI
    bool
    prompt "Support SPI Sample."
    default n
    depends on ENABLE_PERIPHERAL_SAMPLE
    help
        This option means support SPI Sample.

if SAMPLE_SUPPORT_SPI
menu "SPI Sample Configuration"
    osource "application/samples/peripheral/spi/Kconfig"
endmenu
endif

config SAMPLE_SUPPORT_SYSTICK
    bool
    prompt "Support SYSTICK Sample."
    default n
    depends on ENABLE_PERIPHERAL_SAMPLE
    help
        This option means support SYSTICK Sample.

config SAMPLE_SUPPORT_TASKS
    bool
    prompt "Support TASKS Test Sample."
    default n
    depends on ENABLE_PERIPHERAL_SAMPLE
    help
        This option means support TASKS Test Sample.

config SAMPLE_SUPPORT_TCXO
    bool
    prompt "Support TCXO Sample."
    default n
    depends on ENABLE_PERIPHERAL_SAMPLE
    help
        This option means support TCXO Sample.

config SAMPLE_SUPPORT_TIMER
    bool
    prompt "Support TIMER Sample."
    default n
    depends on ENABLE_PERIPHERAL_SAMPLE
    help
        This option means support TIMER Sample.

if SAMPLE_SUPPORT_TIMER
menu "TIMER Sample Configuration"
    osource "application/samples/peripheral/timer/Kconfig"
endmenu
endif

config SAMPLE_SUPPORT_UART
    bool
    prompt "Support UART Sample."
    default n
    depends on ENABLE_PERIPHERAL_SAMPLE
    help
        This option means support UART Sample.

if SAMPLE_SUPPORT_UART
menu "UART Sample Configuration"
    osource "application/samples/peripheral/uart/Kconfig"
endmenu
endif

config SAMPLE_SUPPORT_WDT
    bool
    prompt "Support WATCHDOG Sample."
    default n
    depends on ENABLE_PERIPHERAL_SAMPLE
    help
        This option means support WATCHDOG Sample.

if SAMPLE_SUPPORT_WDT
menu "WATCHDOG Sample Configuration"
    osource "application/samples/peripheral/watchdog/Kconfig"
endmenu
endif
```

## application/samples/peripheral/afe/Kconfig
```kconfig
#===============================================================================
# @brief    Kconfig file.
# Copyright (c) @CompanyNameMagicTag 2023-2023. All rights reserved.
#===============================================================================
config AFE_USE_PIN1
    int
    prompt "Choose AFE USE pin1."
    depends on SAMPLE_SUPPORT_AFE
    default 30

config AFE_USE_PIN2
    int
    prompt "Choose AFE USE pin2."
    depends on SAMPLE_SUPPORT_AFE
    default 31

config AFE_PIN_MODE
    int
    prompt "Choose AFE pin mode."
    default 0
    depends on SAMPLE_SUPPORT_AFE
```

## application/samples/peripheral/blinky/Kconfig
```kconfig
#===============================================================================
# @brief    Kconfig file.
# Copyright (c) @CompanyNameMagicTag 2023-2023. All rights reserved.
#===============================================================================
choice Based
    prompt "Select CMSIS/OSAL Based."
config BLINKY_BASED_CMSIS
    bool "CMSIS Based"

config BLINKY_BASED_OSAL
    bool "OSAL Based"
endchoice


config BLINKY_DURATION_MS
    int
    prompt "Duration of blinky in MS."
    default 500
```

## application/samples/peripheral/i2s_dma/Kconfig
```kconfig
#===============================================================================
# @brief    Kconfig file.
# Copyright (c) @CompanyNameMagicTag 2023-2023. All rights reserved.
#===============================================================================

config I2S_DMA_MAX_RECORD
    int
    prompt "Set the max recorder size of I2S."
    default 2560
    help
        This option means the max recorder size of I2S.

config I2S_TRANSFER_LEN_OF_DMA
    int
    prompt "Set the length of transfer by DMA."
    default 128
    help
        This option means the length of transfer by DMA.
```

## application/samples/peripheral/pdm/Kconfig
```kconfig
#===============================================================================
# @brief    Kconfig file.
# Copyright (c) @CompanyNameMagicTag 2023-2023. All rights reserved.
#===============================================================================
config PDM_D0_PIN
    int
    prompt "Choose PDM D0 pin."
    depends on SAMPLE_SUPPORT_PDM
    default 30

config PDM_CLK0_PIN
    int
    prompt "Choose PDM CLK0 pin."
    depends on SAMPLE_SUPPORT_PDM
    default 31

config PDM_PIN_MODE
    int
    prompt "Choose PDM pin mode."
    default 1
    depends on SAMPLE_SUPPORT_PDM

config PDM_TRANSFER_LEN_BY_DMA
    int
    prompt "Set the length of transfer by DMA."
    default 16
    help
        This option means the length of transfer by DMA.

config PDM_MAX_RECORD_DATA
    hex
    prompt "Set the max recorder size by PDM."
    default 15000
    help
        This option means the max recorder size by PDM.
```

## application/samples/peripheral/pwm/Kconfig
```kconfig
#===============================================================================
# @brief    Kconfig file.
# Copyright (c) @CompanyNameMagicTag 2023-2023. All rights reserved.
#===============================================================================
config PWM_PIN_MODE
    int
    prompt "Choose PWM pin mode."
    default 3
    depends on SAMPLE_SUPPORT_PWM

config PWM_PIN
    int
    prompt "Choose PWM pin."
    depends on SAMPLE_SUPPORT_PWM
    default 20
```
