## application/samples/products/sle_microphone/Kconfig
```kconfig
#===============================================================================
# @brief    Kconfig file.
# Copyright (c) @CompanyNameMagicTag 2023-2023. All rights reserved.
#===============================================================================
config SLE_UAC_TRANSFER_LEN_OF_MICROPH
    int
    prompt "Set the length of transfer by UAC."
    default 256
    help
        This option means the length of transfer by UAC.

config SLE_MTU_LENGTH
    int
    prompt "Set the length of mtu."
    default 490
    help
        This option means the length of mtu.

config SLE_MULTICON_NUM
    int
    prompt "Set the num of sle multicon."
    range 1 2
    default 1
    help
        This option means the length of transfer by UAC.

choice
    prompt "Select SLE Microphone type"
    default SAMPLE_SUPPORT_SLE_MICROPHONE_DONGLE
    config SAMPLE_SUPPORT_SLE_MICROPHONE_DONGLE
        bool "Enable SLE Microphone Dongle sample."
    config SAMPLE_SUPPORT_SLE_MICROPHONE_SERVER
        bool "Enable SLE Microphone Server sample."
endchoice

if SLE_MULTICON_NUM = 1
    config SLE_MULTICON_SERVER1_ADDR0
        hex
        default 0x0A
        prompt "Set the target sle server1 addr[0] of wanting to connect."
        depends on SAMPLE_SUPPORT_SLE_MICROPHONE_DONGLE
        help
            This option means the addr of tartget server wanting to connect.
    config SLE_MULTICON_SERVER1_ADDR1
        hex
        default 0x00
        prompt "Set the target sle server1 addr[1] of wanting to connect."
        depends on SAMPLE_SUPPORT_SLE_MICROPHONE_DONGLE
        help
            This option means the addr of tartget server wanting to connect.
    config SLE_MULTICON_SERVER1_ADDR2
        hex
        default 0x00
        prompt "Set the target sle server1 addr[2] of wanting to connect."
        depends on SAMPLE_SUPPORT_SLE_MICROPHONE_DONGLE
        help
            This option means the addr of tartget server wanting to connect.
    config SLE_MULTICON_SERVER1_ADDR3
        hex
        default 0x00
        prompt "Set the target sle server1 addr[3] of wanting to connect."
        depends on SAMPLE_SUPPORT_SLE_MICROPHONE_DONGLE
        help
            This option means the addr of tartget server wanting to connect.
    config SLE_MULTICON_SERVER1_ADDR4
        hex
        default 0x00
        prompt "Set the target sle server1 addr[4] of wanting to connect."
        depends on SAMPLE_SUPPORT_SLE_MICROPHONE_DONGLE
        help
            This option means the addr of tartget server wanting to connect.
    config SLE_MULTICON_SERVER1_ADDR5
        hex
        default 0x00
        prompt "Set the target sle server1 addr[5] of wanting to connect."
        depends on SAMPLE_SUPPORT_SLE_MICROPHONE_DONGLE
        help
            This option means the addr of tartget server wanting to connect.
endif
if SLE_MULTICON_NUM = 2
    config SLE_EXSIT_TWO_MULTICON_SERVER
        int
        default 1
        depends on SAMPLE_SUPPORT_SLE_MICROPHONE_DONGLE
    config SLE_MULTICON_SERVER1_ADDR0
        hex
        default 0x0A
        prompt "Set the target sle server1 addr[0] of wanting to connect."
        depends on SAMPLE_SUPPORT_SLE_MICROPHONE_DONGLE
        help
            This option means the addr of tartget server wanting to connect.
    config SLE_MULTICON_SERVER1_ADDR1
        hex
        default 0x00
        prompt "Set the target sle server1 addr[1] of wanting to connect."
        depends on SAMPLE_SUPPORT_SLE_MICROPHONE_DONGLE
        help
            This option means the addr of tartget server wanting to connect.
    config SLE_MULTICON_SERVER1_ADDR2
        hex
        default 0x00
        prompt "Set the target sle server1 addr[2] of wanting to connect."
        depends on SAMPLE_SUPPORT_SLE_MICROPHONE_DONGLE
        help
            This option means the addr of tartget server wanting to connect.
    config SLE_MULTICON_SERVER1_ADDR3
        hex
        default 0x00
        prompt "Set the target sle server1 addr[3] of wanting to connect."
        depends on SAMPLE_SUPPORT_SLE_MICROPHONE_DONGLE
        help
            This option means the addr of tartget server wanting to connect.
    config SLE_MULTICON_SERVER1_ADDR4
        hex
        default 0x00
        prompt "Set the target sle server1 addr[4] of wanting to connect."
        depends on SAMPLE_SUPPORT_SLE_MICROPHONE_DONGLE
        help
            This option means the addr of tartget server wanting to connect.
    config SLE_MULTICON_SERVER1_ADDR5
        hex
        default 0x00
        prompt "Set the target sle server1 addr[5] of wanting to connect."
        depends on SAMPLE_SUPPORT_SLE_MICROPHONE_DONGLE
        help
            This option means the addr of tartget server wanting to connect.

    config SLE_MULTICON_SERVER2_ADDR0
        hex
        default 0x0A
        prompt "Set the target sle server2 addr[0] of wanting to connect."
        depends on SAMPLE_SUPPORT_SLE_MICROPHONE_DONGLE
        help
            This option means the addr of tartget server wanting to connect.
    config SLE_MULTICON_SERVER2_ADDR1
        hex
        default 0x00
        prompt "Set the target sle server2 addr[1] of wanting to connect."
        depends on SAMPLE_SUPPORT_SLE_MICROPHONE_DONGLE
        help
            This option means the addr of tartget server wanting to connect.
    config SLE_MULTICON_SERVER2_ADDR2
        hex
        default 0x00
        prompt "Set the target sle server2 addr[2] of wanting to connect."
        depends on SAMPLE_SUPPORT_SLE_MICROPHONE_DONGLE
        help
            This option means the addr of tartget server wanting to connect.
    config SLE_MULTICON_SERVER2_ADDR3
        hex
        default 0x00
        prompt "Set the target sle server2 addr[3] of wanting to connect."
        depends on SAMPLE_SUPPORT_SLE_MICROPHONE_DONGLE
        help
            This option means the addr of tartget server wanting to connect.
    config SLE_MULTICON_SERVER2_ADDR4
        hex
        default 0x00
        prompt "Set the target sle server2 addr[4] of wanting to connect."
        depends on SAMPLE_SUPPORT_SLE_MICROPHONE_DONGLE
        help
            This option means the addr of tartget server wanting to connect.
    config SLE_MULTICON_SERVER2_ADDR5
        hex
        default 0x01
        prompt "Set the target sle server2 addr[5] of wanting to connect."
        depends on SAMPLE_SUPPORT_SLE_MICROPHONE_DONGLE
        help
            This option means the addr of tartget server wanting to connect.
endif

config SLE_MULTICON_SERVER_ADDR0
    hex
    default 0x0A
    prompt "Set the sle server addr[0]."
    depends on SAMPLE_SUPPORT_SLE_MICROPHONE_SERVER
config SLE_MULTICON_SERVER_ADDR1
    hex
    default 0x00
    prompt "Set the sle server addr[1]."
    depends on SAMPLE_SUPPORT_SLE_MICROPHONE_SERVER
config SLE_MULTICON_SERVER_ADDR2
    hex
    default 0x00
    prompt "Set the sle server addr[2]."
    depends on SAMPLE_SUPPORT_SLE_MICROPHONE_SERVER
config SLE_MULTICON_SERVER_ADDR3
    hex
    default 0x00
    prompt "Set the sle server addr[3]."
    depends on SAMPLE_SUPPORT_SLE_MICROPHONE_SERVER
config SLE_MULTICON_SERVER_ADDR4
    hex
    default 0x00
    prompt "Set the sle server addr[4]."
    depends on SAMPLE_SUPPORT_SLE_MICROPHONE_SERVER
config SLE_MULTICON_SERVER_ADDR5
    hex
    default 0x00
    prompt "Set the sle server addr[5]."
    depends on SAMPLE_SUPPORT_SLE_MICROPHONE_SERVER

config SLE_MULTICON_CLIENT_ADDR0
    hex
    default 0x0B
    prompt "Set the sle client addr[0]."
    depends on SAMPLE_SUPPORT_SLE_MICROPHONE_DONGLE
config SLE_MULTICON_CLIENT_ADDR1
    hex
    default 0x00
    prompt "Set the sle client addr[1]."
    depends on SAMPLE_SUPPORT_SLE_MICROPHONE_DONGLE
config SLE_MULTICON_CLIENT_ADDR2
    hex
    default 0x00
    prompt "Set the sle client addr[2]."
    depends on SAMPLE_SUPPORT_SLE_MICROPHONE_DONGLE
config SLE_MULTICON_CLIENT_ADDR3
    hex
    default 0x00
    prompt "Set the sle client addr[3]."
    depends on SAMPLE_SUPPORT_SLE_MICROPHONE_DONGLE
config SLE_MULTICON_CLIENT_ADDR4
    hex
    default 0x00
    prompt "Set the sle client addr[4]."
    depends on SAMPLE_SUPPORT_SLE_MICROPHONE_DONGLE
config SLE_MULTICON_CLIENT_ADDR5
    hex
    default 0x00
    prompt "Set the sle client addr[5]."
    depends on SAMPLE_SUPPORT_SLE_MICROPHONE_DONGLE

config SLE_MULTICON_SERVER_NAME
    string
    prompt "set the name of sle server."
    default "sle_micro_server1"
    depends on SAMPLE_SUPPORT_SLE_MICROPHONE_SERVER
```

## application/samples/products/sle_mouse_with_dongle/Kconfig
```kconfig
#===============================================================================
# @brief    Kconfig file.
# Copyright (c) @CompanyNameMagicTag 2023-2023. All rights reserved.
#===============================================================================

choice
    prompt "Select SLE MOUSE type"
    default SAMPLE_SUPPORT_SLE_MOUSE
    config SAMPLE_SUPPORT_SLE_MOUSE
        bool "Enable SLE MOUSE sample."
        if SAMPLE_SUPPORT_SLE_MOUSE
            osource "application/samples/products/sle_mouse_with_dongle/mouse_sensor/Kconfig"
        endif
    config SAMPLE_SUPPORT_SLE_MOUSE_DONGLE
        bool "Enable SLE MOUSE Dongle sample."

endchoice

if SAMPLE_SUPPORT_SLE_MOUSE_DONGLE
choice
prompt "Select SLE dongle report rate, limit by hardware"
default SAMPLE_SLE_DONGLE_1K
config SAMPLE_SLE_DONGLE_1K
    bool "Sle dongle report rate 1K"
config SAMPLE_SLE_DONGLE_2K
    bool "Sle dongle report rate 2K"
config SAMPLE_SLE_DONGLE_4K
    bool "Sle dongle report rate 4K"
config SAMPLE_SLE_DONGLE_8K
    bool "Sle dongle report rate 8K"
endchoice
endif
```

## application/samples/products/sle_uart/Kconfig
```kconfig
#===============================================================================
# @brief    Kconfig file.
# Copyright (c) @CompanyNameMagicTag 2023-2023. All rights reserved.
#===============================================================================

config SLE_UART_BUS
    int
    prompt "Set the UART BUS of the currrent sample."
    default 0
    depends on SAMPLE_SUPPORT_SLE_UART
    help
        This option means the UART BUS of the currrent sample.

choice
    prompt "Select sle uart type"
    default SAMPLE_SUPPORT_SLE_UART_SERVER
    config SAMPLE_SUPPORT_SLE_UART_SERVER
        bool "Enable SLE UART Server sample."
    config SAMPLE_SUPPORT_SLE_UART_CLIENT
        bool "Enable SLE UART Client sample."
endchoice
```

## application/samples/products/sle_voice_data_trans_with_dongle/Kconfig
```kconfig
#===============================================================================
# @brief    Kconfig file.
# Copyright (c) @CompanyNameMagicTag 2023-2023. All rights reserved.
#===============================================================================

choice
    prompt "Select PDM MIC Channel"
    default SLE_PDM_DMIC_4
    config SLE_PDM_DMIC_4
        bool "PDM DMIC 4"
    config SLE_PDM_DMIC_5
        bool "PDM DMIC 5"
    config SLE_PDM_DMIC_DUAL
        bool "PDM DMIC DUAL"
endchoice

choice
    prompt "Select PDM sample rate"
    default SLE_PDM_SAMPLE_RATE_16K
    config SLE_PDM_SAMPLE_RATE_8K
        bool "PDM sample rate is 8K"
    config SLE_PDM_SAMPLE_RATE_16K
        bool "PDM sample rate is 16K"
    config SLE_PDM_SAMPLE_RATE_32K
        bool "PDM sample rate is 32K"
    config SLE_PDM_SAMPLE_RATE_48K
        bool "PDM sample rate is 48K"
    config SLE_PDM_SAMPLE_RATE_96K
        bool "PDM sample rate is 96K"
endchoice

config USB_UAC_MAX_RECORD
    int
    prompt "Set the max recorder size of USB UAC."
    default 2560
    help
        This option means the max recorder size of USB UAC.

config SLE_PDM_TRANSFER_USING_DMA
    bool
    prompt "Use DMA to transfer the PDM data."
    default y
    help
        This option means use DMA to transfer the PDM data.

config SLE_PDM_TRANSFER_LEN_OF_DMA
    int
    prompt "Set the length of transfer by DMA."
    default 240
    help
        This option means the length of transfer by DMA.

choice
    prompt "Select SLE type"
    default SAMPLE_SUPPORT_SLE_DONGLE
    config SAMPLE_SUPPORT_SLE_DONGLE
        bool "Enable SLE Dongle sample."
    config SAMPLE_SUPPORT_SLE_CLIENT
        bool "Enable SLE Client sample."
endchoice
```

## application/samples/products/usb_micophone/Kconfig
```kconfig
#===============================================================================
# @brief    Kconfig file.
# Copyright (c) @CompanyNameMagicTag 2023-2023. All rights reserved.
#===============================================================================

config ES7243L_DS_MAX_RECORD
    int
    prompt "Set the max recorder size of I2S."
    default 2560
    help
        This option means the max recorder size of I2S.

config ES7243L_DS_TRANSFER_LEN_OF_DMA
    int
    prompt "Set the length of transfer by DMA."
    default 960
    help
        This option means the length of transfer by DMA.
```

## application/samples/products/usb_voice_data_transmission/Kconfig
```kconfig
#===============================================================================
# @brief    Kconfig file.
# Copyright (c) @CompanyNameMagicTag 2023-2023. All rights reserved.
#===============================================================================

choice
    prompt "Select USB PDM MIC Channel"
    default USB_PDM_DMIC_4

    config USB_PDM_DMIC_4
        bool "USB_PDM_DMIC_4"

    config USB_PDM_DMIC_5
        bool "USB_PDM_DMIC_5"

    config USB_PDM_DMIC_DUAL
        bool "USB_PDM_DMIC_DUAL"
endchoice

choice
    prompt "Select PDM sample rate"
    default USB_PDM_SAMPLE_RATE_16K
    config USB_PDM_SAMPLE_RATE_8K
        bool "PDM sample rate is 8K"
    config USB_PDM_SAMPLE_RATE_16K
        bool "PDM sample rate is 16K"
    config USB_PDM_SAMPLE_RATE_32K
        bool "PDM sample rate is 32K"
    config USB_PDM_SAMPLE_RATE_48K
        bool "PDM sample rate is 48K"
    config USB_PDM_SAMPLE_RATE_96K
        bool "PDM sample rate is 96K"
endchoice

config USB_UAC_MAX_RECORD
    int
    prompt "Set the max recorder size of USB UAC."
    default 2560
    help
        This option means the max recorder size of USB UAC.

config USB_PDM_TRANSFER_USING_DMA
    bool
    prompt "Use DMA to transfer the PDM data."
    default y
    help
        This option means use DMA to transfer the PDM data.

config USB_PDM_TRANSFER_LEN_OF_DMA
    int
    prompt "Set the length of transfer by DMA."
    default 128
    help
        This option means the length of transfer by DMA.
```

## drivers/drivers/driver/adc/Kconfig
```kconfig
#===============================================================================
# @brief    Kconfig file.
# Copyright (c) @CompanyNameMagicTag 2022-2022. All rights reserved.
#===============================================================================

config ADC_SUPPORT_AUTO_SCAN
    bool
    prompt "ADC Support auto scan"
    default y
    depends on DRIVER_SUPPORT_ADC

config ADC_SUPPORT_AFE
    bool
    prompt "ADC use Analog front-end mode"
    default n
    depends on DRIVER_SUPPORT_ADC

config ADC_SUPPORT_LONG_SAMPLE
    bool
    prompt "ADC Support long sample mode"
    default n
    depends on ADC_SUPPORT_AUTO_SCAN

config ADC_SUPPORT_DIFFERENTIAL
    bool
    prompt "ADC support differential sample"
    default n
    depends on DRIVER_SUPPORT_ADC
```

## drivers/drivers/driver/dma/Kconfig
```kconfig
#===============================================================================
# @brief    Kconfig file.
# Copyright (c) @CompanyNameMagicTag 2022-2022. All rights reserved.
#===============================================================================
config DMA_SUPPORT_LLI
    bool
    prompt "DMA Support lli"
    default y
    depends on DRIVER_SUPPORT_DMA
	
config DMA_SUPPORT_LPM
    bool
    prompt "DMA Support low power mode"
    default y
    depends on DRIVER_SUPPORT_DMA
```
