## drivers/drivers/driver/i2s/Kconfig
```kconfig
#===============================================================================
# @brief    Kconfig file.
# Copyright (c) @CompanyNameMagicTag 2022-2023. All rights reserved.
#===============================================================================
config I2S_BUS_MAX_NUM
    int
    prompt "I2S_BUS_MAX_NUM"
    default 1
    depends on DRIVER_SUPPORT_I2S

config I2S_SUPPORT_LOOPBACK
    bool
    prompt "I2S_SUPPORT_LOOPBACK"
    default y
    depends on DRIVER_SUPPORT_I2S

config I2S_SUPPORT_DMA
    bool
    prompt "I2S SUPPORT DMA"
    default n
    depends on DRIVER_SUPPORT_I2S
```

## drivers/drivers/driver/pdm/Kconfig
```kconfig
#===============================================================================
# @brief    Kconfig file.
# Copyright (c) @CompanyNameMagicTag 2023-2023. All rights reserved.
#===============================================================================

config PDM_SUPPORT_LPC
    bool
    prompt "PDM Support low power control, control power and clock"
    default n
    depends on DRIVER_SUPPORT_PDM
```

## drivers/drivers/hal/adc/Kconfig
```kconfig
#===============================================================================
# @brief    Kconfig file.
# Copyright (c) @CompanyNameMagicTag 2023-2023. All rights reserved.
#===============================================================================
config ADC_SUPPORT_AMIC
    bool
    prompt "Whether ADC support AMIC."
    default n
    depends on DRIVER_SUPPORT_ADC

config ADC_SUPPORT_HAFE
    bool
    prompt "Whether ADC support HAFE."
    default y
    depends on DRIVER_SUPPORT_ADC

config AFE_SAMPLE_TIMES
    int
    prompt "The numbers ADC sample to average."
    default 3
    depends on DRIVER_SUPPORT_ADC
```
