## drivers/drivers/hal/keyscan/Kconfig
```kconfig
#===============================================================================
# @brief    Kconfig file.
# Copyright (c) @CompanyNameMagicTag 2022-2022. All rights reserved.
#===============================================================================
config KEYSCAN_ENABLE_ALL_CLO
    int
    prompt "number of columns to start"
    default 8
    depends on DRIVER_SUPPORT_KEYSCAN

config KEYSCAN_ENABLE_ALL_ROW
    int
    prompt "number of rows to start"
    default 16
    depends on DRIVER_SUPPORT_KEYSCAN

config KEYSCAN_USE_LP
    bool
    prompt "KEYSCAN v150 uses key_int_lp register when it's going to sleep mode"
    default y
    depends on KEYSCAN_SUPPORT_SLEEP

config KEYSCAN_USE_FULL_KEYS_TYPE
    bool
    prompt "KEYSCAN use full keys type"
    default y
    depends on DRIVER_SUPPORT_KEYSCAN
```

## middleware/utils/at/Kconfig
```kconfig
#===============================================================================
# @brief    Kconfig file.
# Copyright (c) @CompanyNameMagicTag 2022-2023. All rights reserved.
#===============================================================================
config AT_SUPPORT_PLT
    bool
    prompt "platform at command"
    default n
    help
        This option means at support plt.
```

## middleware/utils/dfx/Kconfig
```kconfig
#===============================================================================
# @brief    Kconfig file.
# Copyright (c) @CompanyNameMagicTag 2023-2023. All rights reserved.
#===============================================================================
config DFX_SUPPORT_USERS_PRINT
    bool
    prompt "ENABLE USER TO REGISTER LOG API."
    default y
    depends on MIDDLEWARE_SUPPORT_DFX
```

## protocol/Kconfig
```kconfig
choice
    prompt "Select sle ble support"
    default SUPPORT_SLE_BLE_CENTRAL_PERIPHERAL
    config SUPPORT_SLE_BLE_CENTRAL_PERIPHERAL
        bool "Select sle ble central peripheral"
    config SUPPORT_SLE_BLE_PERIPHERAL
        bool "Select sle ble peripheral"
    config SUPPORT_SLE_PERIPHERAL
        bool "Select sle peripheral"
    config SUPPORT_SLE_CENTRAL
        bool "Select sle central"
    config SUPPORT_BLE_PERIPHERAL
        bool "Select ble peripheral"
    config SUPPORT_BTC_ONLY
        bool "Select btc only"
endchoice

config SLE_BLE_SUPPORT
    string
    default "sle-ble-central-peripheral" if SUPPORT_SLE_BLE_CENTRAL_PERIPHERAL
    default "sle-ble-peripheral" if SUPPORT_SLE_BLE_PERIPHERAL
    default "sle-peripheral" if SUPPORT_SLE_PERIPHERAL
    default "sle-central" if SUPPORT_SLE_CENTRAL
    default "ble-peripheral" if SUPPORT_BLE_PERIPHERAL
    default "btc-only" if SUPPORT_BTC_ONLY

menu "bt_host"
    comment "Config bluetooth."
    osource "protocol/bt/host/Kconfig"
endmenu

config SUPPORT_NFC
    bool
    prompt "Enable nfc support."
    default n
    help
        This option means enable nfc support.
```
